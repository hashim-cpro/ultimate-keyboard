## boards/arm/ultimate_keyboard/Kconfig.board
```kconfig
# Ultimate Keyboard board configuration
# SPDX-License-Identifier: MIT

config BOARD_ULTIMATE_KEYBOARD
    bool "Ultimate Keyboard"
    depends on SOC_NRF52840_QIAA
```

## boards/hashim/ultimate_keyboard/Kconfig.defconfig
```kconfig
# Copyright (c) 2026 Hashim
# SPDX-License-Identifier: MIT

if BOARD_ULTIMATE_KEYBOARD

config ZMK_KEYBOARD_NAME
    default "UltimateKeyboard"

choice ZMK_BOOTMODE_MAGIC_VALUE_BOOTLOADER_TYPE
    default ZMK_BOOTMODE_MAGIC_VALUE_BOOTLOADER_TYPE_ADAFRUIT_NRF52
endchoice

endif # BOARD_ULTIMATE_KEYBOARD
```

## boards/hashim/ultimate_keyboard/ultimate_keyboard_defconfig
```kconfig
# Copyright (c) 2026 Hashim
# SPDX-License-Identifier: MIT

CONFIG_ARM_MPU=y
CONFIG_PINCTRL=y
CONFIG_GPIO=y

CONFIG_USE_DT_CODE_PARTITION=y
CONFIG_BUILD_OUTPUT_UF2=y

CONFIG_MPU_ALLOW_FLASH_WRITE=y
CONFIG_NVS=y
CONFIG_SETTINGS_NVS=y
CONFIG_FLASH=y
CONFIG_FLASH_PAGE_LAYOUT=y
CONFIG_FLASH_MAP=y

CONFIG_ZMK_USB=y
CONFIG_ZMK_BLE=y

CONFIG_ADC=y

CONFIG_LED_STRIP=y
CONFIG_WS2812_STRIP=y
CONFIG_ZMK_RGB_UNDERGLOW=y
CONFIG_ZMK_RGB_UNDERGLOW_EXT_POWER=n
CONFIG_ZMK_RGB_UNDERGLOW_AUTO_OFF_IDLE=y

CONFIG_BT_CTLR_TX_PWR_PLUS_8=y
CONFIG_ZMK_BATTERY_REPORTING=y
CONFIG_ZMK_SLEEP=y
CONFIG_ZMK_IDLE_SLEEP_TIMEOUT=1800000
```

## firmware/boards/hashim/ultimate_keyboard/Kconfig.defconfig
```kconfig
# Copyright (c) 2026 Hashim
# SPDX-License-Identifier: MIT

if BOARD_ULTIMATE_KEYBOARD

config ZMK_KEYBOARD_NAME
    default "Ultimate Keyboard"

# NFC pins P0.09 and P0.10 are matrix rows 3 and 2!
config NFCT_PINS_AS_GPIOS
    default y

# Hardware reset on P0.18 (SW85 button)
config GPIO_AS_PINRESET
    default y

# Enable internal DCDC converters
config BOARD_ENABLE_DCDC
    default y

config BOARD_ENABLE_DCDC_HV
    default y

if USB_DEVICE_STACK

config USB_NRFX
    default y

endif # USB_DEVICE_STACK

config BT_CTLR
    default BT

choice ZMK_BOOTMODE_MAGIC_VALUE_BOOTLOADER_TYPE
    default ZMK_BOOTMODE_MAGIC_VALUE_BOOTLOADER_TYPE_ADAFRUIT_NRF52
endchoice

endif # BOARD_ULTIMATE_KEYBOARD
```

## firmware/boards/hashim/ultimate_keyboard/Kconfig.ultimate_keyboard
```kconfig
# Copyright (c) 2026 Hashim
# SPDX-License-Identifier: MIT

config BOARD_ULTIMATE_KEYBOARD
    select SOC_NRF52840_QIAA
    select ZMK_BOARD_COMPAT
    imply RETAINED_MEM
    imply RETENTION
    imply RETENTION_BOOT_MODE
```

## firmware/boards/hashim/ultimate_keyboard/board.yml
```yaml
board:
  name: ultimate_keyboard
  vendor: hashim
  socs:
    - name: nrf52840
      variants:
        - name: zmk
```
